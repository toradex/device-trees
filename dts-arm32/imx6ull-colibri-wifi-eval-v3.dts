// SPDX-License-Identifier: (GPL-2.0 OR MIT)
/*
 * Copyright 2018-2021 Toradex
 */

/dts-v1/;

#include "imx6ull-colibri-wifi.dtsi"
#include "imx6ull-colibri-eval-v3.dtsi"

/ {
	model = "Toradex Colibri iMX6ULL 512MB Wi-Fi/BT on Colibri Evaluation Board V3";
	compatible = "toradex,colibri-imx6ull-wifi-eval", "fsl,imx6ull";
};

&atmel_mxt_ts {
	pinctrl-0 = <&pinctrl_atmel_adap>;
	interrupt-parent = <&gpio4>;
	interrupts = <16 IRQ_TYPE_EDGE_FALLING>;   /* SODIMM 28, INT */
	reset-gpios = <&gpio2 5 GPIO_ACTIVE_HIGH>; /* SODIMM 30, RST */
	status = "okay";
};

/* PWM <B> */
&pwm5 {
	/* Pin already used by atmel_mxt_ts touchscreen */
	status = "disabled";
};

/* PWM <C> */
&pwm6 {
	/* Pin already used by atmel_mxt_ts touchscreen */
	status = "disabled";
};
