// SPDX-License-Identifier: GPL-2.0+ OR MIT
/*
 * Copyright 2017-2020 Toradex
 */

/dts-v1/;
#include "imx7d-colibri-emmc.dtsi"
#include "imx7-colibri-iris.dtsi"

/ {
	model = "Toradex Colibri iMX7D 1GB on Colibri Iris Board";
	compatible = "toradex,colibri-imx7d-emmc-iris",
		     "toradex,colibri-imx7d-emmc",
		     "toradex,colibri-imx7d",
		     "fsl,imx7d";
};

&usbotg2 {
	vbus-supply = <&reg_usbh_vbus>;
	status = "okay";
};
