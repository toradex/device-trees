// SPDX-License-Identifier: GPL-2.0+ OR MIT
/*
 * Copyright 2021 Toradex
 */

/dts-v1/;

#include "imx6ull-colibri-emmc-nonwifi.dtsi"
#include "imx6ull-colibri-aster.dtsi"

/ {
	model = "Toradex Colibri iMX6ULL 1GB (eMMC) on Colibri Aster";
	compatible = "toradex,colibri-imx6ull-emmc-aster",
		     "toradex,colibri-imx6ull-emmc",
		     "toradex,colibri-imx6ull",
		     "fsl,imx6ull";
};
