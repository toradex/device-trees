// SPDX-License-Identifier: GPL-2.0+ OR MIT
/*
 * Copyright 2017-2020 Toradex
 */

/dts-v1/;
#include "imx7s-colibri.dtsi"
#include "imx7-colibri-iris-v2.dtsi"

/ {
	model = "Toradex Colibri iMX7S on Colibri Iris V2 Board";
	compatible = "toradex,colibri-imx7s-iris-v2",
			"toradex,colibri-imx7s",
			"toradex,colibri-imx7s",
			"fsl,imx7s";
};
