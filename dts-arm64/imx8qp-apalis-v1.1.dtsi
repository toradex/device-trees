// SPDX-License-Identifier: GPL-2.0+ OR X11
/*
 * Copyright 2020 Toradex
 */

#include "imx8qp.dtsi"
#include "imx8-apalis-v1.1.dtsi"

/ {
	model = "Toradex Apalis iMX8QP V1.1";
	compatible = "toradex,apalis-imx8qp-v1.1",
		     "toradex,apalis-imx8qp",
		     "toradex,apalis-imx8",
		     "fsl,imx8qp",
		     "fsl,imx8qm";
};

&cooling_maps_map0 {
	cooling-device =
		<&A53_0 THERMAL_NO_LIMIT THERMAL_NO_LIMIT>,
		<&A53_1 THERMAL_NO_LIMIT THERMAL_NO_LIMIT>,
		<&A53_2 THERMAL_NO_LIMIT THERMAL_NO_LIMIT>,
		<&A53_3 THERMAL_NO_LIMIT THERMAL_NO_LIMIT>,
		<&A72_0 THERMAL_NO_LIMIT THERMAL_NO_LIMIT>;
};
