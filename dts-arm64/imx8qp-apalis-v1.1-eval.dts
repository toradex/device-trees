// SPDX-License-Identifier: GPL-2.0+ OR X11
/*
 * Copyright 2020 Toradex
 */

/dts-v1/;

#include "imx8qp-apalis-v1.1.dtsi"
#include "imx8-apalis-eval.dtsi"

/ {
	model = "Toradex Apalis iMX8QP V1.1 on Apalis Evaluation Board";
	compatible = "toradex,apalis-imx8qp-v1.1-eval",
		     "toradex,apalis-imx8qp-v1.1",
		     "toradex,apalis-imx8-v1.1",
		     "toradex,apalis-imx8",
		     "fsl,imx8qp",
		     "fsl,imx8qm";
};
