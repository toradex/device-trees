// SPDX-License-Identifier: GPL-2.0+ OR X11
/*
 * Copyright 2018-2019 Toradex
 */

/dts-v1/;

#include "dt-bindings/pwm/pwm.h"
#include "imx8qxp-colibri.dtsi"
#include "imx8qxp-colibri-eval-v3.dtsi"

/ {
	model = "Toradex Colibri iMX8QXP/DX with dual channel lvds";
	compatible = "toradex,colibri-imx8x-lvds-dual-eval-v3",
		     "toradex,colibri-imx8x",
		     "fsl,imx8qxp";

};

&iomuxc {
	pinctrl-names = "default";

	colibri-imx8qxp {
		pinctrl_gpio_bklght_on: gpio-bl-on {
			fsl,pins = <
				IMX8QXP_MIPI_DSI1_GPIO0_00_LSIO_GPIO1_IO31	0x00000020
			>;
		};
	};
};
