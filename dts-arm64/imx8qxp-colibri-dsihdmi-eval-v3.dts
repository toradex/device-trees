// SPDX-License-Identifier: GPL-2.0+ OR X11
/*
 * Copyright 2018-2019 Toradex
 */

/dts-v1/;

#include "imx8qxp-colibri.dtsi"
#include "imx8qxp-colibri-eval-v3.dtsi"

/ {
	model = "Toradex Colibri iMX8QXP/DX with LT8912 MIPI-DSI 2 HDMI bridge";
	compatible = "toradex,colibri-imx8x-dsihdmi-eval-v3",
		     "toradex,colibri-imx8x",
		     "fsl,imx8qxp";

};

&iomuxc {
	pinctrl-names = "default";

	colibri-imx8qxp {
		/* DSI/LVDS Hot Plug Detect on FFC (X2) */
		pinctrl_gpio_hpd: gpio-hpd {
			fsl,pins = <
				IMX8QXP_MIPI_DSI1_GPIO0_00_LSIO_GPIO1_IO31	0x20		/* SODIMM 138 */
			>;
		};
	};
};
