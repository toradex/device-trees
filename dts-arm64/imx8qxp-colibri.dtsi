// SPDX-License-Identifier: GPL-2.0+ OR X11
/*
 * Copyright 2018-2021 Toradex
 */

#include "dt-bindings/pwm/pwm.h"
#include "imx8qxp.dtsi"
#include "imx8x-colibri.dtsi"

/ {
	model = "Toradex Colibri iMX8QXP Module";
	compatible = "toradex,colibri-imx8x", "fsl,imx8qxp";
};

&pmic_cooling_map0 {
	cooling-device =
		<&A35_0 THERMAL_NO_LIMIT THERMAL_NO_LIMIT>,
		<&A35_1 THERMAL_NO_LIMIT THERMAL_NO_LIMIT>,
		<&A35_2 THERMAL_NO_LIMIT THERMAL_NO_LIMIT>,
		<&A35_3 THERMAL_NO_LIMIT THERMAL_NO_LIMIT>;
};
