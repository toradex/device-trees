// SPDX-License-Identifier: GPL-2.0+ OR X11
/*
 * Copyright 2019 Toradex
 */

/dts-v1/;

#include "imx8qm-apalis-v1.1.dtsi"
#include "imx8qm-apalis-ixora-v1.1.dtsi"

/ {
	model = "Toradex Apalis iMX8QM/QP V1.1 on Apalis Ixora V1.1 Carrier Board";
	compatible = "toradex,apalis-imx8-v1.1-ixora-v1.1",
		     "toradex,apalis-imx8-v1.1-ixora",
		     "toradex,apalis-imx8-v1.1",
		     "toradex,apalis-imx8",
		     "fsl,imx8qm";
};
