// SPDX-License-Identifier: GPL-2.0+ OR X11
/*
 * Copyright 2018-2021 Toradex
 */

/dts-v1/;

#include "imx8dx-colibri.dtsi"
#include "imx8x-colibri-aster.dtsi"

/ {
	model = "Toradex Colibri iMX8DX on Aster Board";
	compatible = "toradex,colibri-imx8x-aster",
		     "toradex,colibri-imx8x",
		     "fsl,imx8qxp",
		     "fsl,imx8dx";
};
