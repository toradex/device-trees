// SPDX-License-Identifier: GPL-2.0+ OR MIT
/*
 * Copyright 2020 Toradex
 */

/dts-v1/;

#include "imx8mm-verdin-v1.1.dtsi"
#include "imx8mm-verdin-wifi.dtsi"
#include "imx8mm-verdin-dahlia.dtsi"

/ {
	model = "Toradex Verdin iMX8M Mini WB V1.1 on Dahlia Board";
	compatible = "toradex,verdin-imx8mm-wifi-v1.1-dahlia",
		     "toradex,verdin-imx8mm-wifi-dahlia",
		     "toradex,verdin-imx8mm-wifi",
		     "toradex,verdin-imx8mm",
		     "fsl,imx8mm";
};
