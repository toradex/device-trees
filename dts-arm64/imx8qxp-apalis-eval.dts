// SPDX-License-Identifier: GPL-2.0+ OR X11
/*
 * Copyright 2019 Toradex
 */

/dts-v1/;

#include "imx8qxp-apalis.dtsi"
#include "imx8qxp-apalis-eval.dtsi"

/ {
	model = "Toradex Apalis iMX8QXP/DX on Apalis Evaluation Board";
	compatible = "toradex,apalis-imx8x-eval",
		     "toradex,apalis-imx8x",
		     "fsl,imx8qxp";
};
