// SPDX-License-Identifier: GPL-2.0-or-later OR MIT
/*
 * Copyright 2020-2021 Toradex
 */

// SPI generic spidev device for Colibri iMX7.

/dts-v1/;
/plugin/;

/ {
	compatible = "toradex,colibri-imx7d-eval-v3",
		     "toradex,colibri-imx7s-eval-v3";
};

&ecspi3 {
	status = "okay";
};

&mcp2515 {
	status = "disabled";
};

&spidev0 {
	status = "okay";
};
