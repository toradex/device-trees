// LT161010 display (7inch) with a resolution of 800x480 pixel. This display can be ordered at Toradex.

/dts-v1/;
/plugin/;
/ {
	compatible = "toradex,apalis-imx8x";
};

&{/lcdif@5a180000} {
	status = "okay";
};

&{/panel-1} {
	compatible = "panel-dpi";

	width-mm = <217>;
	height-mm = <136>;

	data-mapping = "bgr666";

	panel-timing {
		clock-frequency = <33260000>;
		hactive = <800>;
		vactive = <480>;
		hback-porch = <88>;
		hfront-porch = <40>;
		vback-porch = <32>;
		vfront-porch = <13>;
		hsync-len = <48>;
		vsync-len = <3>;

		de-active = <1>;
		hsync-active = <0>;
		vsync-active = <0>;
		pixelclk-active = <1>;
	};
};

