// SPDX-License-Identifier: GPL-2.0-or-later OR MIT
/*
 * Copyright 2020-2021 Toradex
 */

// Atmel MXT touchscreen for the 7 inch and 10 inch display orderable at Toradex.

/dts-v1/;
/plugin/;

/ {
	compatible = "toradex,verdin-imx8mm",
		     "toradex,verdin-imx8mp";
};

&atmel_mxt_ts {
	status = "okay";
};
