// SPDX-License-Identifier: GPL-2.0-or-later OR MIT
/*
 * Copyright 2020-2021 Toradex
 */

// Set preferred Full-HD mode for HDMI monitor for Apalis-iMX6Q/Colibri-iMX6DL

/dts-v1/;
/plugin/;

/ {
	compatible = "toradex,apalis_imx6q",
		     "toradex,colibri_imx6dl";
};

&mxcfb2 {
	mode_str ="1920x1080M@60";
};
