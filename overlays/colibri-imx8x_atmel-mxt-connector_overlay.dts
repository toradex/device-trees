// SPDX-License-Identifier: GPL-2.0-or-later OR MIT
/*
 * Copyright 2020-2021 Toradex
 */

// Atmel MXT touchscreen for boards with TS connector. Supports the 7 inch and 10 inch display orderable at Toradex.

/dts-v1/;
/plugin/;

/ {
	compatible = "toradex,colibri-imx8x";
};

&atmel_mxt_ts {
	status = "okay";
};

&i2c1 {
	status = "okay";
};
