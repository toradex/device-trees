// SPDX-License-Identifier: GPL-2.0-or-later OR MIT
/*
 * Copyright 2020-2021 Toradex
 */

// Enable the VGA interface on the Apalis iMX6Q

/dts-v1/;
/plugin/;

/ {
	compatible = "toradex,apalis_imx6q";
};

&vdac {
    status = "okay";
};

&mxcfb4 {
    mode_str ="640x480M@60";
    status = "okay";
};
