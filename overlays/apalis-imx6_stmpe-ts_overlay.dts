// SPDX-License-Identifier: GPL-2.0-or-later OR MIT
/*
 * Copyright 2020-2021 Toradex
 */

// Resitive STMPE touchscreen touchscreen for the 7inch display orderable at Toradex.

/dts-v1/;
/plugin/;

/ {
	compatible = "toradex,apalis_imx6q";
};

&stmpe_ts {
	status = "okay";
};
