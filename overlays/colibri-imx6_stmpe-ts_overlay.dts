// SPDX-License-Identifier: GPL-2.0-or-later OR MIT
/*
 * Copyright 2020-2021 Toradex
 */

// Resitive STMPE touchscreen for the 7 inch resistive touch display orderable at Toradex.

/dts-v1/;
/plugin/;

/ {
	compatible = "toradex,colibri_imx6dl";
};

&stmpe_ts {
	status = "okay";
};
