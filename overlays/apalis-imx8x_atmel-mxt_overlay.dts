// SPDX-License-Identifier: GPL-2.0-or-later OR MIT
/*
 * Copyright 2020-2021 Toradex
 */

// Atmel MXT touchscreen for the 7inch and 10inch display orderable at Toradex.

/dts-v1/;
/plugin/;

/ {
	compatible = "toradex,apalis-imx8x";
};

&atmel_mxt_ts {
	status = "okay";
};

&i2c1 {
	status = "okay";
};
