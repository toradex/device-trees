// SPDX-License-Identifier: GPL-2.0-or-later OR MIT
/*
 * Copyright 2021 Toradex
 */

// Fusion F0710A touchscreen. Compatible with a Capacitive Touch Adapter.

/dts-v1/;
/plugin/;

/ {
	compatible = "toradex,colibri-imx6ull-emmc";
};

&atmel_mxt_ts {
	status = "disabled";
};

&fusion_f0710a {
	status = "okay";
};

&i2c1 {
	status = "okay";
};
