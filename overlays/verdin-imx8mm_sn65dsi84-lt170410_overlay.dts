// SPDX-License-Identifier: GPL-2.0-or-later OR MIT
/*
 * Copyright 2020-2021 Toradex
 */

// Verdin DSI to LVDS Adapter with connected LT170410 display (10 inch) with a
// resolution of 1280x800 pixel. Adapter and display can be ordered at Toradex.

/dts-v1/;
/plugin/;

/ {
	compatible = "toradex,verdin-imx8mm";
};

&lvds_ti_sn65dsi83 {
	ti,dsi-lanes = <4>;
	ti,height-mm = <136>;
	ti,lvds-bpp = <24>;
	ti,lvds-format = <2>;
	ti,width-mm = <217>;

	display-timings {
		native-mode = <&lvds_timing0>;

		lvds_timing0: lt170410_2whc {
			/*
			 * Take the minimum pixelclock as 71.1 MHz is
			 * not working on NXP i.MX 8M Mini
			 */
			clock-frequency = <68900000>;
			hactive = <1280 1280 1280>;
			hfront-porch = <23 60 71>;
			hback-porch = <23 60 71>;
			hsync-len = <15 40 47>;
			vactive = <800 800 800>;
			vfront-porch = <5 7 10>;
			vback-porch = <5 7 10>;
			vsync-len = <6 9 12>;
			de-active = <1>;
			pixelclk-active = <0>;
		};
	};
};
