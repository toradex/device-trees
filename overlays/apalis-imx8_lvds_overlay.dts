// SPDX-License-Identifier: GPL-2.0-or-later OR MIT
/*
 * Copyright 2020-2021 Toradex
 */

// Enable a generic LVDS display.

/dts-v1/;
/plugin/;
/ {
	compatible = "toradex,apalis-imx8";
};

&ldb2 {
	status = "okay";
};

&ldb2_phy {
	status = "okay";
};

&panel_lvds {
	status = "okay";
};
