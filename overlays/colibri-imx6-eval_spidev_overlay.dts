// SPDX-License-Identifier: GPL-2.0-or-later OR MIT
/*
 * Copyright 2020-2021 Toradex
 */

// SPI generic spidev device for Colibri iMX6DL.

/dts-v1/;
/plugin/;

/ {
	compatible = "toradex,colibri_imx6dl-eval-v3";
};

&ecspi4 {
	status = "okay";
};

&mcp251x0 {
	status = "disabled";
};

&spidev0 {
	status = "okay";
};
