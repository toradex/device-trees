// SPDX-License-Identifier: GPL-2.0-or-later OR MIT
/*
 * Copyright 2020-2021 Toradex
 */

// EDT5.7 display with a resolution of 640x480 pixel

/dts-v1/;
/plugin/;

/ {
	compatible = "toradex,apalis_imx6q",
		     "toradex,apalis-imx8x",
		     "toradex,colibri_imx6dl",
		     "toradex,colibri-imx6ull",
		     "toradex,colibri-imx7d",
		     "toradex,colibri-imx7s",
		     "toradex,colibri-imx8x";
};

&{/panel-dpi} {
	status = "okay";

	width-mm = <116>;
	height-mm = <86>;

	panel-timing {
		clock-frequency = <25175000>;
		hactive = <640>;
		vactive = <480>;
		hsync-len = <30>;
		hfront-porch = <16>;
		hback-porch = <114>;
		vsync-len = <3>;
		vfront-porch = <10>;
		vback-porch = <32>;
	 };
};
